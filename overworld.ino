#include "dungeon.h"
#include "overworld.h"

int8_t transition = 0;

//up,down,left,right
//1,none,2

uint8_t player_moving = 0;

const uint8_t player_sprites[] PROGMEM = {
// Up
8,8,
B00011000,
B01100110,
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B10000100,
// Down
8,8,
B00011000,
B01100110,
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B10000100,
// Left
8,8,
B00011000,
B01100110,
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B00101000,
// Right
8,8,
B00011000,
B01100110,
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B00010100,
};

const byte tiles[] PROGMEM = {
  8,8,
B00000000,
B00000000,
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B00000000,
};

const byte world[] PROGMEM = {
11,15,1,2,5,15,1,2,3,1,4,38,8,27,4,37,5,1,1,2,1,1,1,2,13,1,1,2,
5,17,11,1,1,2,5,1,1,2,3,1,4,38,1,27,1,11,4,27,1,11,1,27,4,37,5,1,1,2,1,1,1,2,13,1,1,2,
5,17,7,1,1,19,1,1,1,19,1,1,1,2,1,1,1,19,1,1,1,19,1,1,1,2,3,1,4,38,8,27,4,37,5,1,1,2,1,1,1,2,5,1,2,19,6,1,1,2,
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255,17,6,17,
};

#define COMPRESSED_SIZE 2652
//Keep track of this outside the function so we can search incrementally 
uint16_t world_ndx = 0; 
uint16_t world_cnt = 0;
//The world is now run-length encoded to save space, so this function is
//needed to retrieve the actual values for each tile in the map.  This
//can cause substantial overhead, so I keep track of the current index
//globally so that looping accesses to incremental indices don't have to
//loop far at all.
uint8_t world_get(uint16_t index){
  uint8_t curr = 0;
  uint8_t count = 0;

  //Check our global status; if we have already passed the tile, start over
  if( world_cnt > index ){
    world_ndx = 0;
    world_cnt = 0;
  }
  
  for(; world_ndx < COMPRESSED_SIZE; world_ndx += 2){
    curr = pgm_read_byte(&world[world_ndx+1]); //Get tile type
    count = pgm_read_byte(&world[world_ndx]); //Get tile count
    world_cnt += count;
    if( world_cnt > index ){ //If we have now encountered that index
      world_cnt -= count; //Roll back so we can quickly get a tile from the same block
      return curr;
    }
  }
}

uint16_t dudex = 25*8;//10*8;//37*8;//25*8;//8*8;//25*8;
uint16_t dudey = 57*8;//26*8;//49*8;//57*8;//27*8;//57*8;

byte dudeanimation = DOWN;
byte dudeframe = 0;

byte worldframe = 0;

void draw_world(){
  uint8_t tile;
  //gb.display.println(dudex/8 - 6);
  //gb.display.println(dudey/8 - 4);
  //Signed because we may seek off the edge of the map
  for( int8_t y = dudey/8 - 4; y <= dudey/8 + 4; y++ ){
    for( int8_t x = dudex/8 - 6; x <= dudex/8 + 6; x++ ){
      //Draw the tile at the relative distance from the player
      tile = world_get(y*64+x);
      switch( tile ){
        case DRAIN:
        case FLOW:
        case WATER:
        case DOCK1:
        case DOCK2:
        case DOCK3:
          //First 4 are first frame, second 4 are second frame
          if( worldframe >= 0 && worldframe <= 3 ){
            gb.display.drawBitmap( (x*8 - dudex) + SCREEN_WIDTH/2 - 4, (y*8 - dudey) + SCREEN_HEIGHT/2 - 4, &tiles[tile*10] );
          }else{
            //All animated tiles have their variation one tile after it
            gb.display.drawBitmap( (x*8 - dudex) + SCREEN_WIDTH/2 - 4, (y*8 - dudey) + SCREEN_HEIGHT/2 - 4, &tiles[(tile+1)*10] );
          }
          break;
          
        default:
          gb.display.drawBitmap( (x*8 - dudex) + SCREEN_WIDTH/2 - 4, (y*8 - dudey) + SCREEN_HEIGHT/2 - 4, &tiles[tile*10] );
      } 
    }
  }
  //Draw player.  If moving and frames dictate it so, play walking animation
  if( player_moving && (dudeframe/2 == 0 || dudeframe/2 == 2) ){
    gb.display.drawBitmap(SCREEN_WIDTH/2-4,SCREEN_HEIGHT/2-4,player_sprites+((dudeframe/2)+dudeanimation*3)*10);
  }else{
    gb.display.drawBitmap(SCREEN_WIDTH/2-4,SCREEN_HEIGHT/2-4,player_sprites+(1+dudeanimation*3)*10);
  }
}

uint8_t test_world_collision(uint8_t dir){
  uint8_t tile = 0;
  if( dir == UP ){
    tile = world_get(((dudey-1)/8)*64+dudex/8);
    if( tile != DOOR && world_get(((dudey-1)/8)*64+(dudex+7)/8) )
      return world_get(((dudey-1)/8)*64+(dudex+7)/8);
    else
      return tile;
  }else if( dir == DOWN ){
    return world_get(((dudey+8)/8)*64+dudex/8) ||
      world_get(((dudey+8)/8)*64+(dudex+7)/8) != 0;
  }else if( dir == LEFT ){
    return world_get(((dudey)/8)*64+(dudex-1)/8) != 0 ||
      world_get(((dudey+7)/8)*64+(dudex-1)/8) != 0;
  }else{
    return world_get(((dudey)/8)*64+(dudex+8)/8) != 0 ||
      world_get(((dudey+7)/8)*64+(dudex+8)/8) != 0;
  }
}

void step_world(){
  player_moving = 0;
  
  dudeframe++;
  dudeframe%=7;

  worldframe++;
  worldframe%=8;
  
  if( gb.buttons.repeat(BTN_UP,1) ){
    uint8_t collision = 0;
    collision = test_world_collision(UP);
    if( collision == DOOR ){
      //Check whether we collided with a door based on our top left or top right
      collision = world_get(((dudey-1)/8)*64+dudex/8);
      //Depending on which, we set dungeon position to tile x/y of door.
      //This signals to the dungeon generator which dungeon we want to enter.
      uint8_t dungeonx,dungeony;
      if( collision == DOOR ){
        dungeonx = dudex/8;
        dungeony = ((dudey-1)/8);
      }else{
        dungeonx = (dudex+7)/8;
        dungeony = ((dudey-1)/8);
      }
      // Identify the dungeon we are entering
      for( uint8_t i = 0; i < NUM_DUNGEONS; i++ ){
        if( pgm_read_byte(&(dungeons[i].x)) == dungeonx && pgm_read_byte(&(dungeons[i].y)) == dungeony ){
          dungeonid = i;
          break;
        }
      }
      mode = TO_DUNGEON;
      transition = -SCREEN_HEIGHT/2;
      gb.display.persistence = true;
      dungeon_generated = 0;
      dungeon_level = 0;
      previous_level = -1;
      return;
    }
    if( !collision ){
      dudey--;
      dudeanimation = UP;
      player_moving = 1;
    }
  }
  else if(gb.buttons.repeat(BTN_DOWN,1) && !test_world_collision(DOWN)){
    dudey++;
    dudeanimation = DOWN;
    player_moving = 1;
  }
  if(gb.buttons.repeat(BTN_LEFT,1) && !test_world_collision(LEFT)){
    dudex--;
    dudeanimation = LEFT;
    player_moving = 1;
  }
  else if(gb.buttons.repeat(BTN_RIGHT,1) && !test_world_collision(RIGHT)){
    dudex++;
    dudeanimation = RIGHT;
    player_moving = 1;
  }

  if( player_moving ){
    try_combat();
  }
}

